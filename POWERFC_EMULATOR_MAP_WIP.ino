#define BAUD_RATE 19200

///////////// QATIF SPEED FACTORY 
//////////// SALEH.M IBRAHIM 
///////////// APEXI POWER FC ARDUINO SERIAL ADAPTER 

// Define command and response arrays
const byte startcmd[] = {0xF9, 0x02, 0x04};
const byte startrspnd[] = {0xF9, 0x03, 0x07, 0xFC};

const byte enginename[] = {0xF3, 0x02, 0x0A};
//const byte enginenamer[] = {0xF3, 0x0A, 0x51, 0x41, 0x54, 0x49, 0x46, 0xD5}; //QATIF
//F3 0a 32 4A 5A 2D 47 54 45 31 EE 2JZGTE 
const byte enginenamer[] = {0xF3, 0x0A, 0x52, 0x42, 0x32, 0x36, 0x44,0x45, 0x54, 0x54, 0xD5}; //RB26
//const byte enginenamer[] = {0xF3, 0x0A, 0x32, 0x4A, 0x5A, 0x2D, 0x47,0x54, 0x45, 0x31, 0xEE}; //2JZGTE

//const byte enginenamer[] = {0xF3, 0x0A, 0x31, 0x33, 0x42, 0x2D, 0x52,0x45, 0x57, 0x20, 0x21}; //13B
//52 42 32 36 44 45 54 54
const byte ver[] = {0xF5, 0x02, 0x08};
const byte verr[] = {0xF5, 0x07, 0x38, 0x2E, 0x30, 0x34, 0x41, 0xF8};


const byte menuboot[] = {0xD7, 0x02, 0x26};
const byte menubootr[] = {0xD7, 0x14, 0x00, 0x00, 0x01, 0x00, 0x01, 0x02, 0x03, 0x00, 0x01, 0x02, 0x03, 0x04, 0x05, 0x06, 0x07, 0x04, 0x00, 0x01, 0xEC};

const byte menudata[] = {0xCA, 0x02, 0x33};

const byte menudata_full[] = {0xCA, 0x52, 0x00, 0x00, 0xCD, 0x05, 0xB3, 0x08, 0x99, 0x0B, 0x7F, 0x0E, 0x66,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 0x23, 0xCA};

const byte monitorreqr[] = {0xF2, 0x02, 0x0B};

const byte tracer[] = {0xDB, 0x02, 0x22};
const byte rtracer[] = {0xDB, 0x04, 0x00, 0x00, 0x20};

const byte MAP_DATA_REQ1[] = {0xC1, 0x02, 0x3C};
const byte MAP_DATA_REQ2[] = {0xC2, 0x02, 0x3B};
const byte MAP_DATA_REQ3[] = {0xC3, 0x02, 0x3A};
const byte MAP_DATA_REQ4[] = {0xC4, 0x02, 0x39};

const byte MAP_DATA_RSP[] = {
0xC1,0x66,
0x00, 0x00, 0x00, 0x00, 0x00, 0x00, 0x00, 0x00, 0x00, 0x00, //10 
0x00, 0x00, 0x00, 0x00, 0x00, 0x00, 0x00, 0x00, 0x00, 0x00, //20
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0x00, 0x00, 0x00, 0x00, 0x00, 0x00, 0x00, 0x00, 0x00, 0x00 //100
,0xD8

};
const byte MAP_DATA2_RSP[] = {
0xC2, 0x66,//////////// sector command
0x00, 0x00, 0x00, 0x00, 0x00, 0x00, 0x00, 0x00, 0x00, 0x00, //10 MAP DATA
0x00, 0x00, 0x00, 0x00, 0x00, 0x00, 0x00, 0x00, 0x00, 0x00, //20
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0x00, 0x00, 0x00, 0x00, 0x00, 0x00, 0x00, 0x00, 0x00, 0x00 //100
,0xD7        //////// sector end  

};
const byte MAP_DATA3_RSP[] = {
0xC3, 0x66,       //////////// sector command
0x00, 0x00, 0x00, 0x00, 0x00, 0x00, 0x00, 0x00, 0x00, 0x00, //10  MAP DATA
0x00, 0x00, 0x00, 0x00, 0x00, 0x00, 0x00, 0x00, 0x00, 0x00, //20  MAP DATA
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0x00, 0x00, 0x00, 0x00, 0x00, 0x00, 0x00, 0x00, 0x00, 0x00 //100
,0xD6 //////// sector end 
};
const byte MAP_DATA4_RSP[] = {
0xC4, 0x66, //////////// sector command
0x00, 0x00, 0x00, 0x00, 0x00, 0x00, 0x00, 0x00, 0x00, 0x00, //10  MAP DATA 
0x00, 0x00, 0x00, 0x00, 0x00, 0x00, 0x00, 0x00, 0x00, 0x00, //20
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0x00, 0x00, 0x00, 0x00, 0x00, 0x00, 0x00, 0x00, 0x00, 0x00 //100
,0xD5 //////// sector end 
};



void sendResponse(const byte *response, size_t responseSize);

void setup() {
  Serial3.begin(BAUD_RATE, SERIAL_8E1);
}

void loop() {
  static byte commandBuffer[21]; // BFR
  static int commandIndex = 0; // BFFR
  static bool isMonitorReq = false; // MonReq flag
  if (Serial3.available() > 0) {
    byte currentByte = Serial3.read(); 

    // Check for command sequences
    if (currentByte == startcmd[0] || currentByte == enginename[0] || currentByte == ver[0] || currentByte == menuboot[0] || currentByte == menudata[0] 
    || currentByte == tracer[0] ||currentByte == MAP_DATA_REQ1[0] ||currentByte == MAP_DATA_REQ2[0] ||currentByte == MAP_DATA_REQ3[0] ||currentByte == MAP_DATA_REQ4[0] ||  currentByte == 0xD7) {
      // Start of a potential command sequence
      commandBuffer[0] = currentByte;
      commandIndex = 1;
      isMonitorReq = (currentByte == 0xD7); 
    } else if (commandIndex > 0) {
      commandBuffer[commandIndex] = currentByte;
      commandIndex++;

      if (commandIndex == 3) {
        // Check for START REQ
        if (commandBuffer[0] == startcmd[0] && commandBuffer[1] == startcmd[1] && commandBuffer[2] == startcmd[2]) {
          sendResponse(startrspnd, sizeof(startrspnd));
          commandIndex = 0;
        }
        // ENGINE NAME
        else if (commandBuffer[0] == enginename[0] && commandBuffer[1] == enginename[1] && commandBuffer[2] == enginename[2]) {
          sendResponse(enginenamer, sizeof(enginenamer));
          commandIndex = 0;
        }
        // VER
        else if (commandBuffer[0] == ver[0] && commandBuffer[1] == ver[1] && commandBuffer[2] == ver[2]) {
          sendResponse(verr, sizeof(verr));
          commandIndex = 0;
        }
        // MENU REQUEST
        else if (commandBuffer[0] == menuboot[0] && commandBuffer[1] == menuboot[1] && commandBuffer[2] == menuboot[2]) {
          sendResponse(menubootr, sizeof(menubootr));
          commandIndex = 0;
        }
        // MENU DATA
        else if (commandBuffer[0] == menudata[0] && commandBuffer[1] == menudata[1] && commandBuffer[2] == menudata[2]) {
          sendResponse(menudata, sizeof(menudata));
          commandIndex = 0;
        }
        // TRACER
        else if (commandBuffer[0] == tracer[0] && commandBuffer[1] == tracer[1] && commandBuffer[2] == tracer[2]) {
          sendResponse(rtracer, sizeof(rtracer));
          commandIndex = 0;
        }
         else if (commandBuffer[0] == MAP_DATA_REQ1[0] && commandBuffer[1] == MAP_DATA_REQ1[1] && commandBuffer[2] == MAP_DATA_REQ1[2]) {
          sendResponse(MAP_DATA_RSP, sizeof(MAP_DATA_RSP));
          commandIndex = 0;
        }
         else if (commandBuffer[0] == MAP_DATA_REQ2[0] && commandBuffer[1] == MAP_DATA_REQ2[1] && commandBuffer[2] == MAP_DATA_REQ2[2]) {
          sendResponse(MAP_DATA2_RSP, sizeof(MAP_DATA2_RSP));
          commandIndex = 0;
        }
          else if (commandBuffer[0] == MAP_DATA_REQ3[0] && commandBuffer[1] == MAP_DATA_REQ3[1] && commandBuffer[2] == MAP_DATA_REQ3[2]) {
          sendResponse(MAP_DATA3_RSP, sizeof(MAP_DATA3_RSP));
          commandIndex = 0;
        }
          else if (commandBuffer[0] == MAP_DATA_REQ4[0] && commandBuffer[1] == MAP_DATA_REQ4[1] && commandBuffer[2] == MAP_DATA_REQ4[2]) {
          sendResponse(MAP_DATA4_RSP, sizeof(MAP_DATA4_RSP));
          commandIndex = 0;
        }
      }
      if (isMonitorReq && commandIndex == 21) {
        sendResponse(monitorreqr, sizeof(monitorreqr));
        commandIndex = 0; 
        isMonitorReq = false; 
      }
    }
  }
}

void sendResponse(const byte *response, size_t responseSize) {
  for (size_t i = 0; i < responseSize; i++) {
    Serial3.write(response[i]);
  }
}


